## conf/layer.conf
```bitbake
# We have a conf and classes directory, add to BBPATH
BBPATH .= ":${LAYERDIR}"

# We have recipes-* directories, add to BBFILES
BBFILES += "${LAYERDIR}/recipes-*/*/*.bb \
            ${LAYERDIR}/recipes-*/*/*.bbappend"

BBFILE_COLLECTIONS += "imx-avt-layer"
BBFILE_PATTERN_imx-avt-layer = "^${LAYERDIR}/"
BBFILE_PRIORITY_imx-avt-layer = "6"


LAYERDEPENDS_imx-avt-layer = "core fsl-bsp-release"
LAYERSERIES_COMPAT_imx-avt-layer = "kirkstone"
```
